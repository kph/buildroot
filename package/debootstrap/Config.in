## package/debootstrap/Config.in
```kconfig
config BR2_PACKAGE_DEBOOTSTRAP
	bool "cdebootstrap"
	select BR2_PACKAGE_DEBIAN_ARCHIVE_KEYRING
	depend BR2_PACKAGE_BUSYBOX
	depend BR2_PACKAGE_PERL
	help
	  debootstrap generates systems from scratch for Debian and
	  derivates.

	  https://packages.debian.org/debootstrap
```
